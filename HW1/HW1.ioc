# file: HW1.ioc
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Mcu.Family=STM32F4
Mcu.Name=STM32F401C(D-E)Ux
Mcu.Package=UFQFPN48
NVIC.PriorityGroup=NVIC_PRIORITYGROUP_4
NVIC.TIM2_IRQn=true\:0\:0\:false\:false\:true\:true\:true\:true
PA13.Mode=Serial_Wire
PA13.Signal=SYS_JTMS-SWDIO
PA14.Mode=Serial_Wire
PA14.Signal=SYS_JTCK-SWCLK
PH0\ -\ OSC_IN.Mode=HSE-External-Oscillator
PH0\ -\ OSC_IN.Signal=RCC_OSC_IN
PH1\ -\ OSC_OUT.Mode=HSE-External-Oscillator
PH1\ -\ OSC_OUT.Signal=RCC_OSC_OUT
ProjectManager.HeapSize=0x200
ProjectManager.StackSize=0x400
ProjectManager.TargetToolchain=STM32CubeIDE
RCC.48MHZClocksFreq_Value=36000000
RCC.AHBFreq_Value=72000000
RCC.APB1CLKDivider=RCC_HCLK_DIV2
RCC.APB1Freq_Value=36000000
RCC.APB1TimFreq_Value=72000000
RCC.APB2Freq_Value=72000000
RCC.APB2TimFreq_Value=72000000
RCC.CortexFreq_Value=72000000
RCC.HCLKFreq_Value=72000000
RCC.HSE_VALUE=25000000
RCC.HSI_VALUE=16000000
RCC.LSE_VALUE=32768
RCC.PLLM=25
RCC.PLLN=144
RCC.PLLSourceVirtual=RCC_PLLSOURCE_HSE
RCC.SYSCLKFreq_VALUE=72000000
RCC.SYSCLKSource=RCC_SYSCLKSOURCE_PLLCLK
RCC.VCOOutputFreq_Value=144000000
TIM2.Period=0
TIM2.Prescaler=720
VP_TIM2_VS_ClockSourceINT.Mode=Internal
board=custom

// file: Core/Src/main.c
/* USER CODE BEGIN Header */
/**
  ******************************************************************************
  * @file           : main.c
  * @brief          : Main program body
  ******************************************************************************
  * @attention
  *
  * Copyright (c) 2025 STMicroelectronics.
  * All rights reserved.
  *
  * This software is licensed under terms that can be found in the LICENSE file
  * in the root directory of this software component.
  * If no LICENSE file comes with this software, it is provided AS-IS.
  *
  ******************************************************************************
  */
/* USER CODE END Header */
#include "main.h"

// Member
// 65070502406 Kittiphop Phanthachart
// 65070502424 NOPPAMIN PIRAWATCHARAPAISARN
// 65070502427 NIRACHA PHOPHUANG

TIM_HandleTypeDef htim2;

int 	Count_Timer =0;

int Count_State=0;

void GPIOA_Config(void) {
    // Enable GPIOA clock
    RCC -> AHB1ENR |= (0x01 << 0);
    // Config 		PA1 			as input
    // Config (PA1 to PA3) and PA6  as output

    GPIOA -> MODER |= (0x00 << (0* 2));
    GPIOA -> MODER |= (0x01 << (1* 2)); //LED 1
    GPIOA -> MODER |= (0x01 << (2* 2)); //LED 2
    GPIOA -> MODER |= (0x01 << (3* 2)); //LED 3
    GPIOA -> MODER |= (0x01 << (6* 2)); //Blink

    // Set output type
    // ALL GPIO (PB) is  Output push-pull
    GPIOA-> OTYPER &= (0x00);

    // ALL GPIO (PA) Speed is High speed Output
    GPIOA -> OSPEEDR |= ~(0x00);

    // Enable PA0  pull-up
    GPIOA->PUPDR |= (0x01 << (0 * 2));

    // Disable (PA1 to PA3) and PA6  pull-up
    GPIOA->PUPDR |= (0x00 << (1 * 2));
    GPIOA->PUPDR |= (0x00 << (2 * 2));
    GPIOA->PUPDR |= (0x00 << (3 * 2));
    GPIOA->PUPDR |= (0x00 << (6 * 2));
}

void GPIOB_Config(void) {
	// Enable GPIOC Clock
	RCC -> AHB1ENR |= (0x01 << 1);

	// Config PB10 as Output
	GPIOB -> MODER |= (0x01 << (10* 2));

    // Set output type
    // ALL GPIO (PB) is  Output push-pull
	GPIOB-> OTYPER &= (0x00);

	// ALL GPIO (PBA) Speed is High speed Output
	GPIOB -> OSPEEDR |= ~(0x00);

	// Disable PA10  pull-up
	GPIOB->PUPDR |= (0x00 << (10 * 2));
}

void GPIOC_Config(void)
{
    // step 1 : enable GPIOB clock
    RCC -> AHB1ENR |= (0x01 << 2);
    // step 2 : Config PB1 as input
    GPIOC -> MODER &= ~(0x03 << (13 * 2));
    GPIOC->PUPDR  |= (0x01 << (13 * 2));

}

unsigned char Read_PC13(void)
{
    return (GPIOC -> IDR & (0x01 << 13)) ? 1 : 0;
}

unsigned char Read_PA0(void)
{
    return (GPIOA -> IDR & (0x01 << 0)) ? 1 : 0;
}

void HAL_TIM_PeriodElapsedCallback(TIM_HandleTypeDef* htim)
{
	if(htim -> Instance == TIM2)
	{
		Count_Timer++;
		GPIOB -> ODR ^= (1 << 10);
	}
}

/* USER CODE END PV */

void SystemClock_Config(void);
static void MX_GPIO_Init(void);
static void MX_TIM2_Init(void);

int main(void)
{

  /* MCU Configuration--------------------------------------------------------*/

  /* Reset of all peripherals, Initializes the Flash interface and the Systick. */
  HAL_Init();

  /* Configure the system clock */
  SystemClock_Config();

  /* Initialize all configured peripherals */
  MX_GPIO_Init();
  MX_TIM2_Init();
  /* USER CODE BEGIN 2 */
  GPIOA_Config();
    GPIOB_Config();
    GPIOC_Config();
    HAL_TIM_Base_Start_IT(&htim2);

  /* USER CODE END 2 */

  /* Infinite loop */
  /* USER CODE BEGIN WHILE */
    uint8_t led_state = 0;
       uint8_t last_button_state = 0;

           while(1)
           {
         	  uint8_t button_state = Read_PA0();

               if(button_state  == 0 && last_button_state == 1 )
               {
             	  Count_State ++;
             	   if (Count_State >=4)
     			  {
             		  Count_State = 0;
     			  }
               }

               if (Count_State == 0)
               			  {
               				  GPIOA -> ODR |= (0x01 << 1);
               				  GPIOA -> ODR &= ~(0x01 << 2);
               				  GPIOA -> ODR &= ~(0x01 << 3);
               			  }
               			  else if (Count_State == 1)
               			  {
               				  GPIOA -> ODR &= ~(0x01 << 1);
               				  GPIOA -> ODR |= (0x01 << 2);
               				  GPIOA -> ODR &= ~(0x01 << 3);
               			  }
               			  else if (Count_State == 2)
               			  {
               				  GPIOA -> ODR &= ~(0x01 << 1);
               				  GPIOA -> ODR &= ~(0x01 << 2);
               				  GPIOA -> ODR |= (0x01 << 3);
               			  }
               			  else if (Count_State == 3)
               			  {
               				  GPIOA -> ODR |= (0x01 << 1);
     						  GPIOA -> ODR |= (0x01 << 2);
     						  GPIOA -> ODR |= (0x01 << 3);
               			  }

               if (Count_Timer >= 60)
     			{
     			GPIOA -> ODR ^= (1 << 6);
     			 Count_Timer = 0;
     			}

               last_button_state = button_state;
       /* USER CODE END 3 */
           }
  /* USER CODE END 3 */
}

void SystemClock_Config(void)
{
  RCC_OscInitTypeDef RCC_OscInitStruct = {0};
  RCC_ClkInitTypeDef RCC_ClkInitStruct = {0};

  /** Configure the main internal regulator output voltage
  */
  __HAL_RCC_PWR_CLK_ENABLE();
  __HAL_PWR_VOLTAGESCALING_CONFIG(PWR_REGULATOR_VOLTAGE_SCALE2);

  /** Initializes the RCC Oscillators according to the specified parameters
  * in the RCC_OscInitTypeDef structure.
  */
  RCC_OscInitStruct.OscillatorType = RCC_OSCILLATORTYPE_HSE;
  RCC_OscInitStruct.HSEState = RCC_HSE_ON;
  RCC_OscInitStruct.PLL.PLLState = RCC_PLL_ON;
  RCC_OscInitStruct.PLL.PLLSource = RCC_PLLSOURCE_HSE;
  RCC_OscInitStruct.PLL.PLLM = 25;
  RCC_OscInitStruct.PLL.PLLN = 144;
  RCC_OscInitStruct.PLL.PLLP = RCC_PLLP_DIV2;
  RCC_OscInitStruct.PLL.PLLQ = 4;
  if (HAL_RCC_OscConfig(&RCC_OscInitStruct) != HAL_OK)
  {
    Error_Handler();
  }

  /** Initializes the CPU, AHB and APB buses clocks
  */
  RCC_ClkInitStruct.ClockType = RCC_CLOCKTYPE_HCLK|RCC_CLOCKTYPE_SYSCLK
                              |RCC_CLOCKTYPE_PCLK1|RCC_CLOCKTYPE_PCLK2;
  RCC_ClkInitStruct.SYSCLKSource = RCC_SYSCLKSOURCE_PLLCLK;
  RCC_ClkInitStruct.AHBCLKDivider = RCC_SYSCLK_DIV1;
  RCC_ClkInitStruct.APB1CLKDivider = RCC_HCLK_DIV2;
  RCC_ClkInitStruct.APB2CLKDivider = RCC_HCLK_DIV1;

  if (HAL_RCC_ClockConfig(&RCC_ClkInitStruct, FLASH_LATENCY_2) != HAL_OK)
  {
    Error_Handler();
  }
}

static void MX_TIM2_Init(void)
{

  TIM_ClockConfigTypeDef sClockSourceConfig = {0};
  TIM_MasterConfigTypeDef sMasterConfig = {0};

  htim2.Instance = TIM2;
  htim2.Init.Prescaler = 720-1;
  htim2.Init.CounterMode = TIM_COUNTERMODE_UP;
  htim2.Init.Period = 1;
  htim2.Init.ClockDivision = TIM_CLOCKDIVISION_DIV1;
  htim2.Init.AutoReloadPreload = TIM_AUTORELOAD_PRELOAD_DISABLE;
  if (HAL_TIM_Base_Init(&htim2) != HAL_OK)
  {
    Error_Handler();
  }
  sClockSourceConfig.ClockSource = TIM_CLOCKSOURCE_INTERNAL;
  if (HAL_TIM_ConfigClockSource(&htim2, &sClockSourceConfig) != HAL_OK)
  {
    Error_Handler();
  }
  sMasterConfig.MasterOutputTrigger = TIM_TRGO_RESET;
  sMasterConfig.MasterSlaveMode = TIM_MASTERSLAVEMODE_DISABLE;
  if (HAL_TIMEx_MasterConfigSynchronization(&htim2, &sMasterConfig) != HAL_OK)
  {
    Error_Handler();
  }

}

static void MX_GPIO_Init(void)
{

  /* GPIO Ports Clock Enable */
  __HAL_RCC_GPIOH_CLK_ENABLE();
  __HAL_RCC_GPIOA_CLK_ENABLE();

}

void Error_Handler(void)
{
  __disable_irq();
  while (1)
  {
  }
}
